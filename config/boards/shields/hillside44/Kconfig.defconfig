## config/boards/shields/hillside44/Kconfig.defconfig
```kconfig
# Copyright (c) 2021-2022 The ZMK Contributors
# SPDX-License-Identifier: MIT

if SHIELD_HILLSIDE44_LEFT

config ZMK_KEYBOARD_NAME
    default "Hillside44"

config ZMK_SPLIT_BLE_ROLE_CENTRAL
    default y

endif

if SHIELD_HILLSIDE44_LEFT || SHIELD_HILLSIDE44_RIGHT

config ZMK_SPLIT
    default y

endif
```

## config/boards/shields/hillside44/Kconfig.shield
```kconfig
# Copyright (c) 2021-2022 The ZMK Contributors
# SPDX-License-Identifier: MIT

config SHIELD_HILLSIDE44_LEFT
    def_bool $(shields_list_contains,hillside44_left)

config SHIELD_HILLSIDE44_RIGHT
    def_bool $(shields_list_contains,hillside44_right)
```
